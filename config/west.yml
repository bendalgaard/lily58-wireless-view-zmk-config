## config/west.yml
```yaml
manifest:
  remotes:
    - name: zmkfirmware
      url-base: https://github.com/zmkfirmware
    - name: bendalgaard
      url-base: https://github.com/bendalgaard
  projects:
    - name: zmk
      remote: zmkfirmware
      revision: main
      import: app/west.yml
    - name: bendalgaard
      revision: main
  self:
    path: config
```
